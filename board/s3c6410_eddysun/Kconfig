## board/s3c6410_eddysun/Kconfig
```kconfig
if TARGET_S3C6410_EDDYSUN

config SYS_BOARD
	default "s3c6410_eddysun"

config SYS_SOC
	default "s3c6410"

config SYS_CONFIG_NAME
	default "s3c6410_eddysun"

endif
```

## configs/s3c6410_eddysun_defconfig
```kconfig
CONFIG_ARM=y
CONFIG_TARGET_S3C6410_EDDYSUN=y
CONFIG_BOOTDELAY=3
CONFIG_SYS_PROMPT="uboot> "
#CONFIG_CMD_I2C=y
# CONFIG_CMD_SETEXPR is not set
#CONFIG_CMD_PING=y
```
